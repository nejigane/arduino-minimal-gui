#include "Font.h"

static const uint8_t data[1151] PROGMEM = {
  0,34,248,248,13,13,21,56,56,0,56,56,0,0,0,0,
  0,21,96,248,96,248,96,3,15,3,15,3,6,96,144,248,
  248,144,32,2,4,15,15,4,3,6,56,40,184,192,112,24,
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  6,6,48,24,24,48,48,24,0,0,0,0,0,0
};

namespace minimal {

void Font::getData(const char* string, uint8_t* buffer, uint8_t bufferLength, bool isUpper) {  
  while(*string != '\0' && bufferLength > 0) {
    uint8_t code = *string;
    if (code < 32 || code > 126) code = 32;

    const uint8_t* d = data;
    uint8_t c = 32;
    while (c <= code) {
      uint8_t info = pgm_read_byte(d);
      uint8_t offset = info >> 4;
      uint8_t width = info & 15;

      if (c == code) {
        buffer += offset;
        bufferLength = bufferLength > offset ? bufferLength - offset : 0;
        d += isUpper ? 1 : 1 + width;
        for (uint8_t i = 0; i < width && bufferLength > 0; ++i, ++d, ++buffer, --bufferLength)
          *buffer |= pgm_read_byte(d);
        buffer += 7 - (offset + width);
        break;
      }

      d += 1 + width * 2;
      ++c;
    }

    ++string;
  }
}

}